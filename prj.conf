## Kconfig
```
#
# Copyright (c) 2020 Nordic Semiconductor ASA
#
# SPDX-License-Identifier: LicenseRef-Nordic-5-Clause
#

menu "Zephyr Kernel"
source "Kconfig.zephyr"
endmenu

module = COAP_SERVER
module-str = CoAP server
source "${ZEPHYR_BASE}/subsys/logging/Kconfig.template.log_config"

module = OT_COAP_UTILS
module-str = OpenThread CoAP utils
source "${ZEPHYR_BASE}/subsys/logging/Kconfig.template.log_config"


module = OT_SRP_UTILS
module-str = OpenThread SRP utils
source "${ZEPHYR_BASE}/subsys/logging/Kconfig.template.log_config"

module = DALI
module-str = Dali Transciever
source "${ZEPHYR_BASE}/subsys/logging/Kconfig.template.log_config"
```

## prj.conf
```kconfig
#
# Copyright (c) 2020 Nordic Semiconductor
#
# SPDX-License-Identifier: LicenseRef-Nordic-5-Clause
#

# nRF board library
CONFIG_DK_LIBRARY=y

# Enable OpenThread CoAP support API
CONFIG_OPENTHREAD_COAP=y

# Configure sample logging setting
CONFIG_LOG=y
CONFIG_COAP_SERVER_LOG_LEVEL_DBG=y
CONFIG_OT_COAP_UTILS_LOG_LEVEL_DBG=y
CONFIG_OT_SRP_UTILS_LOG_LEVEL_DBG=y
CONFIG_DALI_LOG_LEVEL_DBG=y
CONFIG_OPENTHREAD_LOG_LEVEL_NOTE=y
CONFIG_OPENTHREAD_DEBUG=y
CONFIG_DK_LIBRARY_LOG_LEVEL_DBG=y

# Adjust log strdup settings

# Network shell
CONFIG_SHELL=y
CONFIG_OPENTHREAD_SHELL=y
CONFIG_SHELL_ARGC_MAX=26
CONFIG_SHELL_CMD_BUFF_SIZE=416

# Network sockets
CONFIG_NET_SOCKETS=y
CONFIG_NET_SOCKETS_POSIX_NAMES=y
CONFIG_NET_SOCKETS_POLL_MAX=4

# Same network Master Key for client and server
CONFIG_OPENTHREAD_NETWORKKEY="bd:0f:11:e8:32:21:ac:8e:52:c0:e1:87:df:42:b2:92"

# L2 OpenThread enabling
CONFIG_NET_L2_OPENTHREAD=y

# Generic networking options
CONFIG_NETWORKING=y

CONFIG_ASSERT=y
CONFIG_ASSERT_NO_COND_INFO=y
CONFIG_MBEDTLS_SHA1_C=n
CONFIG_FPU=y

# Timers and whatnot
CONFIG_NRFX_PWM0=y
CONFIG_NRFX_PWM1=y
CONFIG_NRFX_TIMER1=y
CONFIG_NRFX_TIMER2=y


# Stuff I've added
CONFIG_OPENTHREAD_SLAAC=y
CONFIG_OPENTHREAD_SRP_CLIENT=y
CONFIG_OPENTHREAD_COAPS=y
# CONFIG_LOG_BACKEND_UART=y
# CONFIG_LOG_BACKEND_RTT=n
CONFIG_OPENTHREAD_COAP_BLOCK=y
CONFIG_OPENTHREAD_COAP_OBSERVE=y
CONFIG_DK_LIBRARY_DYNAMIC_BUTTON_HANDLERS=n
```

## src/coap_server.c
```c
/*
 * Copyright (c) 2020 Nordic Semiconductor ASA
 *
 * SPDX-License-Identifier: LicenseRef-Nordic-5-Clause
 */

#include <zephyr/kernel.h>
#include <dk_buttons_and_leds.h>
#include <zephyr/logging/log.h>
#include <zephyr/net/openthread.h>
#include <zephyr/drivers/gpio.h>
#include <openthread/srp_client.h>
#include <openthread/thread.h>

#include "ot_coap_utils.h"
#include "dali.h"
#include "srp_utils.h"

#include <hal/nrf_gpio.h>


LOG_MODULE_REGISTER(coap_server, CONFIG_COAP_SERVER_LOG_LEVEL);

#define OT_CONNECTION_LED DK_LED1
#define PROVISIONING_LED DK_LED3
#define LIGHT_LED DK_LED4

static struct k_work provisioning_work;
static struct k_work send_dali_cmd;

static struct k_timer led_timer;
static struct k_timer provisioning_timer;
static volatile int buttonPressCount = 0;



static void on_light_request(uint8_t command)
{
	static uint8_t val;

	switch (command) {
	case THREAD_COAP_UTILS_LIGHT_CMD_ON:
		dk_set_led_on(LIGHT_LED);
		val = 1;
		break;

	case THREAD_COAP_UTILS_LIGHT_CMD_OFF:
		dk_set_led_off(LIGHT_LED);
		val = 0;
		break;

	case THREAD_COAP_UTILS_LIGHT_CMD_TOGGLE:
		val = !val;
		dk_set_led(LIGHT_LED, val);
		break;

	default:
		break;
	}
}

static void activate_provisioning(struct k_work *item)
{
	ARG_UNUSED(item);

	ot_coap_activate_provisioning();

	k_timer_start(&led_timer, K_MSEC(100), K_MSEC(100));
	k_timer_start(&provisioning_timer, K_SECONDS(5), K_NO_WAIT);

	LOG_INF("Provisioning activated");
}


static void do_send_dali_command(struct k_work *item) {
	// Send out some stuff.
	buttonPressCount++;
	LOG_DBG("Button presses: %d", buttonPressCount);
	dk_set_led(OT_CONNECTION_LED, buttonPressCount % 2);
	dali_send(buttonPressCount, 16);
}

static void deactivate_provisionig(void)
{
	k_timer_stop(&led_timer);
	k_timer_stop(&provisioning_timer);

	if (ot_coap_is_provisioning_active()) {
		ot_coap_deactivate_provisioning();
		LOG_INF("Provisioning deactivated");
	}
}

static void on_provisioning_timer_expiry(struct k_timer *timer_id)
{
	ARG_UNUSED(timer_id);

	deactivate_provisionig();
}

static void on_led_timer_expiry(struct k_timer *timer_id)
{
	static uint8_t val = 1;

	ARG_UNUSED(timer_id);

	dk_set_led(PROVISIONING_LED, val);
	val = !val;
}

static void on_led_timer_stop(struct k_timer *timer_id)
{
	ARG_UNUSED(timer_id);

	dk_set_led_off(PROVISIONING_LED);
}

static void on_button_changed(uint32_t button_state, uint32_t has_changed)
{
	uint32_t buttons = button_state & has_changed;
	if (buttons & DK_BTN1_MSK) {
		k_work_submit(&send_dali_cmd);
	}

	if (buttons & DK_BTN4_MSK) {
		k_work_submit(&provisioning_work);
	}
}

static void on_thread_state_changed(uint32_t flags, void *context)
{
	struct openthread_context *ot_context = context;

	if (flags & OT_CHANGED_THREAD_ROLE) {
		switch (otThreadGetDeviceRole(ot_context->instance)) {
		case OT_DEVICE_ROLE_CHILD:
		case OT_DEVICE_ROLE_ROUTER:
		case OT_DEVICE_ROLE_LEADER:
			dk_set_led_on(OT_CONNECTION_LED);
			break;

		case OT_DEVICE_ROLE_DISABLED:
		case OT_DEVICE_ROLE_DETACHED:
		default:
			dk_set_led_off(OT_CONNECTION_LED);
			deactivate_provisionig();
			break;
		}
	}
}


void main(void)
{
	int ret;

	LOG_INF("Start CoAP-server sample");

	k_timer_init(&led_timer, on_led_timer_expiry, on_led_timer_stop);
	k_timer_init(&provisioning_timer, on_provisioning_timer_expiry, NULL);

	k_work_init(&provisioning_work, activate_provisioning);
	k_work_init(&send_dali_cmd, do_send_dali_command);

	ret = ot_coap_init(&deactivate_provisionig, &on_light_request);
	if (ret) {
		LOG_ERR("Could not initialize OpenThread CoAP");
		goto end;
	}

	ret = srp_init();
	if (ret) {
		LOG_ERR("Could not initialize OpenThread SRP");
		goto end;
	}

	dali_read_init();
	dali_write_init();


	ret = dk_leds_init();
	if (ret) {
		LOG_ERR("Could not initialize leds, err code: %d", ret);
		goto end;
	}


	ret = dk_buttons_init(on_button_changed);
	if (ret) {
		LOG_ERR("Cannot init buttons (error: %d)", ret);
		goto end;
	}

	openthread_set_state_changed_cb(on_thread_state_changed);
	openthread_start(openthread_get_default_context());

end:
	return;
}
```

## src/dali.c
```c
#include <zephyr/logging/log.h>
#include <zephyr/net/net_pkt.h>
#include <zephyr/net/net_l2.h>
#include <zephyr/net/openthread.h>
#include <openthread/coap.h>
#include <openthread/srp_client.h>
#include <openthread/ip6.h>
#include <openthread/message.h>
#include <openthread/thread.h>
#include <coap_server_client_interface.h>
#include <nrfx_gpiote.h>
#include <nrfx_ppi.h>
#include <nrfx_timer.h>
#include <nrfx_pwm.h>
#include "srp_utils.h"

LOG_MODULE_REGISTER(dali, CONFIG_DALI_LOG_LEVEL);


#define NRFX_ERROR_CHECK(ERR_CODE)                           \
    do                                                      \
    {                                                       \
        const uint32_t LOCAL_ERR_CODE = (ERR_CODE);         \
        __ASSERT((LOCAL_ERR_CODE) == NRFX_SUCCESS, "Call at %s:%d returned %d", (const char*) __FILE__, __LINE__, LOCAL_ERR_CODE); \
    } while (0)


#define INPUT_PIN 4
#define OUTPUT_PIN 3
#define BIT_WIDTH_US 833
#define HALF_BIT_WIDTH_US (BIT_WIDTH_US/2) 
#define PWM_INVERT 0x8000
#define MAX_DALI_BITS 32
#define PULSEWIDTH_TOLERANCE 20


static uint16_t outputSequenceValues[MAX_DALI_BITS+3];
static nrf_pwm_sequence_t outputSequence = {
	.values = { .p_common =  outputSequenceValues },
	.length = 1,
	.repeats = 0,
	.end_delay = 0
};

static nrfx_pwm_t pwm = NRFX_PWM_INSTANCE(1);
static nrfx_pwm_config_t pwmConfig = {
	.output_pins = { OUTPUT_PIN, NRFX_PWM_PIN_NOT_USED, NRFX_PWM_PIN_NOT_USED, NRFX_PWM_PIN_NOT_USED },
	.irq_priority = NRFX_PWM_DEFAULT_CONFIG_IRQ_PRIORITY,
	.base_clock = NRF_PWM_CLK_1MHz,
	.count_mode = NRF_PWM_MODE_UP,
	.top_value = 833,
	.step_mode = NRF_PWM_STEP_AUTO,
	.load_mode = NRF_PWM_LOAD_COMMON,
	.skip_gpio_cfg = false,
	.skip_psel_cfg = false
};

static nrfx_timer_t timer = NRFX_TIMER_INSTANCE(2);
static nrfx_timer_config_t timer_cfg = NRFX_TIMER_DEFAULT_CONFIG;


typedef enum pulsewidth_type {
	PW_INVALID,
	PW_SHORT,
	PW_LONG,
	PW_TIMEOUT,
} pulsewidth_type_t;


struct input_state_t;
typedef struct input_state_t *(state_callback_t)(enum pulsewidth_type pulse_width);

struct input_state_t {
	char *name;
	state_callback_t *handler;
	uint32_t timeout;
};


static volatile uint32_t lastInputToggle;
// We start in the ERROR state, until we see an idle line for at least x Usec. 
static volatile struct input_state_t *currentInputState = NULL;


nrfx_gpiote_in_config_t inputGpioteConfig = {
	.sense = NRF_GPIOTE_POLARITY_TOGGLE,
	.pull = NRF_GPIO_PIN_PULLUP,
	.is_watcher = false,
	.hi_accuracy = true,
	.skip_gpio_setup = false,
};



static uint32_t inputShiftReg = 0;
static size_t inputBitCount = 0;
static uint32_t lastInputBit;


#define DISABLE_TIMEOUT UINT32_MAX-1


static struct input_state_t *idle_handleTransition(pulsewidth_type_t pulse_width);
static struct input_state_t *inStartBit_handleTransition(pulsewidth_type_t pulse_width);
static struct input_state_t *inResettingCurrentlyLow_handleTransition(pulsewidth_type_t pulse_width);
static struct input_state_t *inResettingCurrentlyHigh_handleTransition(pulsewidth_type_t pulse_width);
static struct input_state_t *inHalfBit_handleTransition(pulsewidth_type_t pulse_width);
static struct input_state_t *atStartOfBit_handleTransition(pulsewidth_type_t pulse_width);

static struct input_state_t idleState = {
	.name = "idle",
	.handler = idle_handleTransition,
	.timeout = DISABLE_TIMEOUT, // We never timeout.
};

static struct input_state_t inStartBitState = {
	.name = "start",
	.handler = inStartBit_handleTransition,
	.timeout = HALF_BIT_WIDTH_US*3/2,
};

static struct input_state_t resettingCurrentlyLowState = {
	.name = "r_low",
	.handler = inResettingCurrentlyLow_handleTransition,
	.timeout = BIT_WIDTH_US*2, // After this time, we transition back out
};

static struct input_state_t resettingCurrentlyHighState = {
	.name = "r_high",
	.handler = inResettingCurrentlyHigh_handleTransition,
	.timeout = BIT_WIDTH_US*2, // If its held high for this long, then that is bad.
};

static struct input_state_t inHalfBitState = {
	.name = "h",
	.handler = inHalfBit_handleTransition,
	.timeout = BIT_WIDTH_US*3/2,
};

static struct input_state_t atStartOfBitState = {
	.name = "s",
	.handler = atStartOfBit_handleTransition,
	.timeout = BIT_WIDTH_US*2,
};



void processInput() {
	uint32_t value = inputShiftReg;
	uint32_t numBits = inputBitCount;

	LOG_INF("Received 0x%02x, size %d", value, numBits);

	inputShiftReg = 0;
	inputBitCount = 0;
}

static inline void pushBit(uint32_t value) {
	inputShiftReg = (inputShiftReg << 1) | (value ? 1 : 0);
	inputBitCount++;
}

static struct input_state_t *getResetState() {
	uint32_t currentVal = nrf_gpio_pin_read(INPUT_PIN);

	// Which reset state we go into depends on which level we are currently at
	return currentVal ? &resettingCurrentlyHighState : &resettingCurrentlyLowState ;
}



static struct input_state_t *idle_handleTransition(pulsewidth_type_t pulse_width) {
	return &inStartBitState;
}


static struct input_state_t *inStartBit_handleTransition(pulsewidth_type_t pulse_width) {
	if (pulse_width != PW_SHORT) {
		// Wasn't a valid first half of a start bit, but we were high
		return &resettingCurrentlyHighState;
	} else {
		lastInputBit = 1;
		inputShiftReg = 0;
		inputBitCount = 0;
		return &inHalfBitState;
	}
}


static struct input_state_t *inResettingCurrentlyLow_handleTransition(pulsewidth_type_t pulse_width) {
	if (pulse_width == PW_TIMEOUT) {
		// We're out of purgatory, and now back in idle.
		return &idleState;
	}
	
	// If we get here, we've gone back high again, which is bad
	return getResetState();
}


static struct input_state_t *inResettingCurrentlyHigh_handleTransition(pulsewidth_type_t pulse_width) {
	// A timeout here indicates the bus has been held for too long a time.  
	// Somebody has done something illegal. 
	if (pulse_width == PW_TIMEOUT) {
		// Double check it isn't us by releasing the output
		LOG_DBG("Resetting output");

		nrf_gpio_pin_clear(OUTPUT_PIN);
		// But we stay in the current state.
		return getResetState();
	}
	// Otherwise, we're returning back to reset low
	return &resettingCurrentlyLowState;
}



static struct input_state_t *inHalfBit_handleTransition(pulsewidth_type_t pulse_width) {
	switch (pulse_width) {
		case PW_SHORT:
			// short pulse takes us to the start of the next bit, and the next pulse _must_ also be a short, 
			// and it will be the same bit as we just had.
			return &atStartOfBitState;

		case PW_LONG:
			// It was a long pulse, which means a new bit of the opposite type, but afterwards we're still in a half bit.
			lastInputBit = lastInputBit ? 0 : 1;
			pushBit(lastInputBit);
			return &inHalfBitState;

		case PW_TIMEOUT:
			if (lastInputBit) {
				// The line is now idle, and has been for 2.5 bit lengths.  That mean's we're done with the transfer.
				processInput();
				return &idleState;
			} else {
				// We've been stuck low for too long.  This is bad.
				return getResetState();
			}
			break;

		default:
			// All others are invlaid, so we reset. 
			return getResetState();
	}
}


static struct input_state_t *atStartOfBit_handleTransition(pulsewidth_type_t pulse_width) {
	// After a short pulse (from a half bit), the only valid transition is another short pulse, 
	// unless we are ending (had a timeout and the last bit was a 0) 
	switch (pulse_width) {
		case PW_SHORT:
			// We're done processing the last bit, and have started the next one (but its the same bit orientation than the last one.)
			pushBit(lastInputBit);
			return &inHalfBitState;

		case PW_TIMEOUT:
			if (!lastInputBit) {
				// We've received 2 stop bits, and the line is idle, so its an end to the receive..
				processInput();
				return &idleState;
			} 
			return getResetState();

		default:
			// all other transitions are invalid.
			return getResetState();
	}	
}




pulsewidth_type_t getPulseWidthType(uint32_t pulseWidth) {
	if (pulseWidth < HALF_BIT_WIDTH_US-PULSEWIDTH_TOLERANCE) {
		return PW_INVALID;
	} else if (pulseWidth < HALF_BIT_WIDTH_US+PULSEWIDTH_TOLERANCE) {
		return PW_SHORT;
	} else if (pulseWidth < BIT_WIDTH_US-PULSEWIDTH_TOLERANCE) {
		return PW_INVALID;
	} else if (pulseWidth < BIT_WIDTH_US+PULSEWIDTH_TOLERANCE) {
		return PW_LONG;
	} else {
		return PW_INVALID;
	}
}


void processStateMachine(pulsewidth_type_t pulse_width, uint32_t ticks) {
	struct input_state_t *newState = currentInputState->handler(pulse_width);

	// In some modes (IDLE), we don't have a timeout
	if (newState != currentInputState) {
		nrf_timer_cc_set(timer.p_reg, NRF_TIMER_CC_CHANNEL1, newState->timeout);
		if (currentInputState->timeout == DISABLE_TIMEOUT && newState->timeout != DISABLE_TIMEOUT) {
			// We've gone from disabled to enabled.
			LOG_DBG("Starting timer");
			// nrfx_timer_clear(&timer);
			// nrfx_timer_enable(&timer);			
		} else if (currentInputState->timeout != DISABLE_TIMEOUT && newState->timeout == DISABLE_TIMEOUT) {
			// gone enabled to disabled.
			// nrfx_timer_disable(&timer);
		}		
	}
	LOG_DBG("Transition pulse %u=%d led to %s->%s", ticks, pulse_width, currentInputState->name, newState->name);
	currentInputState = (struct input_state_t *) newState;
}

/**
 * @brief interrupt callback for level changes on the input pin
 * 
 * @param pin 
 * @param _action 
 */
void inputChanged(nrfx_gpiote_pin_t pin, nrf_gpiote_polarity_t _action) {
	// Each time our input level changes, we use our state machine to work out what happens next.
	if (pin == INPUT_PIN) {
		uint32_t cc = nrfx_timer_capture_get(&timer, NRF_TIMER_CC_CHANNEL0);
		uint32_t pulseWidth = cc;
		pulsewidth_type_t pwt = getPulseWidthType(pulseWidth);
		processStateMachine(pwt, cc);
	}
}


/**
 */
static void timer_callback(nrf_timer_event_t event_type, void* p_context) {
	if (event_type == NRF_TIMER_EVENT_COMPARE1) {
		LOG_DBG("Timeout");
		// Called when a timeout occurs. 
		processStateMachine(PW_TIMEOUT, 0);
		// TODO do we need to clear any pending input changes?
	}
}


static void pwm_handler(nrfx_pwm_evt_type_t event_type, void *p_context) {
	if (event_type == NRFX_PWM_EVT_FINISHED) {
		LOG_DBG("PWM send finished\n");
	}
}


nrfx_err_t dali_init() {
	// Turn on GPIOTE
	LOG_DBG("Enabling DALI module");

	// Configure timer
	timer_cfg.frequency = NRF_TIMER_FREQ_1MHz;
	timer_cfg.bit_width = NRF_TIMER_BIT_WIDTH_32;
	timer_cfg.mode = NRF_TIMER_MODE_TIMER;

	// For some bizarre reason, nrfx doesn't enable its own IRQ, so we do it for them.
	IRQ_DIRECT_CONNECT(TIMER2_IRQn, 0, nrfx_timer_2_irq_handler, 0);
    NRFX_ERROR_CHECK(nrfx_timer_init(&timer, &timer_cfg, timer_callback));


	// Configure Input for GPIOTE, on either edge
	nrfx_gpiote_in_init(INPUT_PIN, &inputGpioteConfig, inputChanged);
	nrfx_gpiote_in_event_enable(INPUT_PIN, true);

	// Set up PPI to capture the current time whenever the input toggles, then clear the timer (ready for the next transition)
	nrf_ppi_channel_t captureTransitionTimeChannel;
	NRFX_ERROR_CHECK(nrfx_ppi_channel_alloc(&captureTransitionTimeChannel));
	NRFX_ERROR_CHECK(nrfx_ppi_channel_assign(
						captureTransitionTimeChannel, 
						nrfx_gpiote_in_event_addr_get(INPUT_PIN),
						nrfx_timer_task_address_get(&timer, NRF_TIMER_TASK_CAPTURE0)
					));
	nrfx_ppi_channel_fork_assign(captureTransitionTimeChannel, nrfx_timer_task_address_get(&timer, NRF_TIMER_TASK_CLEAR));
    NRFX_ERROR_CHECK(nrfx_ppi_channel_enable(captureTransitionTimeChannel));

	// Also set a timer that goes off if we've stayed in any one value for too long (resetting us back to a different state.)
	nrfx_timer_extended_compare(&timer, NRF_TIMER_CC_CHANNEL1, 3*BIT_WIDTH_US, NRF_TIMER_SHORT_COMPARE1_CLEAR_MASK, true);
	nrfx_timer_clear(&timer);	

	// NRFX is not setting up the IRQ properly, so we use our own
	IRQ_DIRECT_CONNECT(PWM1_IRQn, 0, nrfx_pwm_1_irq_handler, 0);
	NRFX_ERROR_CHECK(nrfx_pwm_init(&pwm, &pwmConfig, pwm_handler, NULL));


	// Our initial state depends on what value the bus is currently at.  It will be one of the reset states, which means we will wait
	// until the bus is idle before startng to read.
	currentInputState = getResetState();
	nrfx_timer_enable(&timer);
	return 0;
}



void dali_send(uint32_t output, size_t numBits) {
	int bitPos = 0;

	__ASSERT(numBits <= MAX_DALI_BITS, "Attempt to send more than 32 bits via dali");

	// First bit is a start bit (a logical 1)
	outputSequenceValues[bitPos++] = PWM_INVERT | HALF_BIT_WIDTH_US;

	// Loop through each of the bits, starting with the MSB
	for (uint32_t bitMask = 1 << (numBits-1); bitMask != 0; bitMask >>=1) {
		// We always have the same duty, but we flip the polarity depending on if the bit is set or not.
		outputSequenceValues[bitPos++] = ((output & bitMask) ? 0x8000 : 0) | HALF_BIT_WIDTH_US;
	}
	// Add the stop bits (2 bit periods where it is just high)
	outputSequenceValues[bitPos++] = PWM_INVERT;
	outputSequenceValues[bitPos++] = PWM_INVERT;
	outputSequence.length = bitPos;

	nrfx_pwm_simple_playback(&pwm, &outputSequence, 1, 0);
}
```

## src/dali.h
```c
#ifndef __DALI_H__
#define __DALI_H__

#include <inttypes.h>
#include <strings.h>

#define DALI_INPUT_PIN 4
#define DALI_OUTPUT_PIN 3
#define BIT_WIDTH_US 833
#define HALF_BIT_WIDTH_US (BIT_WIDTH_US/2) 


nrfx_err_t dali_read_init();
nrfx_err_t dali_write_init();

void dali_abort_write();
void dali_send(uint32_t output, size_t numBits);

#endif
```

## src/dali_read.c
```c
#include <zephyr/logging/log.h>
#include <zephyr/net/net_pkt.h>
#include <zephyr/net/net_l2.h>
#include <zephyr/net/openthread.h>
#include <openthread/coap.h>
#include <openthread/srp_client.h>
#include <openthread/ip6.h>
#include <openthread/message.h>
#include <openthread/thread.h>
#include <coap_server_client_interface.h>
#include <nrfx_gpiote.h>
#include <nrfx_ppi.h>
#include <nrfx_timer.h>
#include <nrfx_pwm.h>
#include "srp_utils.h"
#include "dali.h"

LOG_MODULE_REGISTER(dali, CONFIG_DALI_LOG_LEVEL);


#define NRFX_ERROR_CHECK(ERR_CODE)                           \
    do                                                      \
    {                                                       \
        const uint32_t LOCAL_ERR_CODE = (ERR_CODE);         \
        __ASSERT((LOCAL_ERR_CODE) == NRFX_SUCCESS, "Call at %s:%d returned %d", (const char*) __FILE__, __LINE__, LOCAL_ERR_CODE); \
    } while (0)


#define PULSEWIDTH_TOLERANCE 20
#define DISABLE_TIMEOUT UINT32_MAX-1



typedef enum pulsewidth_type {
	PW_INVALID,
	PW_SHORT,
	PW_LONG,
	PW_TIMEOUT,
} pulsewidth_type_t;

typedef struct input_state_t *(state_callback_t)(enum pulsewidth_type pulse_width);


struct input_state_t {
	state_callback_t *handler;
	uint32_t timeout;
};



nrfx_gpiote_in_config_t inputGpioteConfig = {
	.sense = NRF_GPIOTE_POLARITY_TOGGLE,
	.pull = NRF_GPIO_PIN_PULLUP,
	.is_watcher = false,
	.hi_accuracy = true,
	.skip_gpio_setup = false,
};


static nrfx_timer_t timer = NRFX_TIMER_INSTANCE(2);
static nrfx_timer_config_t timer_cfg = NRFX_TIMER_DEFAULT_CONFIG;
struct input_state_t;
static volatile uint32_t lastInputToggle;
// We start in the ERROR state, until we see an idle line for at least x Usec. 
static volatile struct input_state_t *currentInputState = NULL;
static uint32_t inputShiftReg = 0;
static size_t inputBitCount = 0;
static uint32_t lastInputBit;
static nrf_ppi_channel_t inputTogglePPIchannel;



static struct input_state_t *idle_handleTransition(pulsewidth_type_t pulse_width);
static struct input_state_t *inStartBit_handleTransition(pulsewidth_type_t pulse_width);
static struct input_state_t *inResettingCurrentlyLow_handleTransition(pulsewidth_type_t pulse_width);
static struct input_state_t *inResettingCurrentlyHigh_handleTransition(pulsewidth_type_t pulse_width);
static struct input_state_t *inHalfBit_handleTransition(pulsewidth_type_t pulse_width);
static struct input_state_t *atStartOfBit_handleTransition(pulsewidth_type_t pulse_width);

static struct input_state_t idleState = {
	.handler = idle_handleTransition,
	.timeout = DISABLE_TIMEOUT, // We never timeout.
};

static struct input_state_t inStartBitState = {
	.handler = inStartBit_handleTransition,
	.timeout = HALF_BIT_WIDTH_US*3/2,
};

static struct input_state_t resettingCurrentlyLowState = {
	.handler = inResettingCurrentlyLow_handleTransition,
	.timeout = BIT_WIDTH_US*2, // After this time, we transition back out
};

static struct input_state_t resettingCurrentlyHighState = {
	.handler = inResettingCurrentlyHigh_handleTransition,
	.timeout = BIT_WIDTH_US*2, // If its held high for this long, then that is bad.
};

static struct input_state_t inHalfBitState = {
	.handler = inHalfBit_handleTransition,
	.timeout = BIT_WIDTH_US*3/2,
};

static struct input_state_t atStartOfBitState = {
	.handler = atStartOfBit_handleTransition,
	.timeout = BIT_WIDTH_US*2,
};



static void processInput() {
	uint32_t value = inputShiftReg;
	uint32_t numBits = inputBitCount;

	LOG_INF("Received 0x%02x, size %d", value, numBits);

	inputShiftReg = 0;
	inputBitCount = 0;
}

static inline void pushBit(uint32_t value) {
	inputShiftReg = (inputShiftReg << 1) | (value ? 1 : 0);
	inputBitCount++;
}

static struct input_state_t *getResetState() {
	uint32_t currentVal = nrf_gpio_pin_read(DALI_INPUT_PIN);

	// Which reset state we go into depends on which level we are currently at
	return currentVal ? &resettingCurrentlyHighState : &resettingCurrentlyLowState ;
}

static struct input_state_t *cancelTransmitThenGetResetState() {
	dali_abort_write();
	return getResetState();
}



static struct input_state_t *idle_handleTransition(pulsewidth_type_t pulse_width) {
	return &inStartBitState;
}


static struct input_state_t *inStartBit_handleTransition(pulsewidth_type_t pulse_width) {
	if (pulse_width != PW_SHORT) {
		// Wasn't a valid first half of a start bit, but we were high
		return &resettingCurrentlyHighState;
	} else {
		lastInputBit = 1;
		inputShiftReg = 0;
		inputBitCount = 0;
		return &inHalfBitState;
	}
}


static struct input_state_t *inResettingCurrentlyLow_handleTransition(pulsewidth_type_t pulse_width) {
	if (pulse_width == PW_TIMEOUT) {
		// We're out of purgatory, and now back in idle.
		return &idleState;
	}
	
	// If we get here, we've gone back high again, which is bad
	return getResetState();
}


static struct input_state_t *inResettingCurrentlyHigh_handleTransition(pulsewidth_type_t pulse_width) {
	// A timeout here indicates the bus has been held for too long a time.  
	// Somebody has done something illegal. 
	if (pulse_width == PW_TIMEOUT) {
		// Double check it isn't us by releasing the output

		nrf_gpio_pin_clear(DALI_OUTPUT_PIN);
		LOG_ERR("Resetting output, as its stuck in a shorted state.");
		// But we stay in the current state.
		return getResetState();
	}
	// Otherwise, we're returning back to reset low
	return &resettingCurrentlyLowState;
}



static struct input_state_t *inHalfBit_handleTransition(pulsewidth_type_t pulse_width) {
	switch (pulse_width) {
		case PW_SHORT:
			// short pulse takes us to the start of the next bit, and the next pulse _must_ also be a short, 
			// and it will be the same bit as we just had.
			return &atStartOfBitState;

		case PW_LONG:
			// It was a long pulse, which means a new bit of the opposite type, but afterwards we're still in a half bit.
			lastInputBit = lastInputBit ? 0 : 1;
			pushBit(lastInputBit);
			return &inHalfBitState;

		case PW_TIMEOUT:
			if (lastInputBit) {
				// The line is now idle, and has been for 2.5 bit lengths.  That mean's we're done with the transfer.
				processInput();
				return &idleState;
			} else {
				// We've been stuck low for too long.  This is bad.
				return cancelTransmitThenGetResetState();
			}
			break;

		default:
			// All others are invlaid, so we reset. 
			return cancelTransmitThenGetResetState();
	}
}


static struct input_state_t *atStartOfBit_handleTransition(pulsewidth_type_t pulse_width) {
	// After a short pulse (from a half bit), the only valid transition is another short pulse, 
	// unless we are ending (had a timeout and the last bit was a 0) 
	switch (pulse_width) {
		case PW_SHORT:
			// We're done processing the last bit, and have started the next one (but its the same bit orientation than the last one.)
			pushBit(lastInputBit);
			return &inHalfBitState;

		case PW_TIMEOUT:
			if (!lastInputBit) {
				// We've received 2 stop bits, and the line is idle, so its an end to the receive..
				processInput();
				return &idleState;
			} 
			return cancelTransmitThenGetResetState();

		default:
			// all other transitions are invalid.
			return cancelTransmitThenGetResetState();
	}	
}




pulsewidth_type_t getPulseWidthType(uint32_t pulseWidth) {
	if (pulseWidth < HALF_BIT_WIDTH_US-PULSEWIDTH_TOLERANCE) {
		return PW_INVALID;
	} else if (pulseWidth < HALF_BIT_WIDTH_US+PULSEWIDTH_TOLERANCE) {
		return PW_SHORT;
	} else if (pulseWidth < BIT_WIDTH_US-PULSEWIDTH_TOLERANCE) {
		return PW_INVALID;
	} else if (pulseWidth < BIT_WIDTH_US+PULSEWIDTH_TOLERANCE) {
		return PW_LONG;
	} else {
		return PW_INVALID;
	}
}


void processStateMachine(pulsewidth_type_t pulse_width, uint32_t ticks) {
	struct input_state_t *newState = currentInputState->handler(pulse_width);

	// In some modes (IDLE), we don't have a timeout
	if (newState != currentInputState) {
		nrf_timer_cc_set(timer.p_reg, NRF_TIMER_CC_CHANNEL1, newState->timeout);
		if (currentInputState->timeout == DISABLE_TIMEOUT && newState->timeout != DISABLE_TIMEOUT) {
			// Switch our PPI second task to do a capture upon next toggle. 
	        nrf_ppi_fork_endpoint_setup(NRF_PPI, inputTogglePPIchannel, nrfx_timer_task_address_get(&timer, NRF_TIMER_TASK_CAPTURE0));
		} else if (currentInputState->timeout != DISABLE_TIMEOUT && newState->timeout == DISABLE_TIMEOUT) {
			nrfx_timer_pause(&timer);
			nrfx_timer_clear(&timer);

			// Switch our PPI second task to start the timer upon next toggle
	        nrf_ppi_fork_endpoint_setup(NRF_PPI, inputTogglePPIchannel, nrfx_timer_task_address_get(&timer, NRF_TIMER_TASK_START));
		}		
	}
	currentInputState = (struct input_state_t *) newState;
}

/**
 * @brief interrupt callback for level changes on the input pin
 * 
 * @param pin 
 * @param _action 
 */
void inputChanged(nrfx_gpiote_pin_t pin, nrf_gpiote_polarity_t _action) {
	// Each time our input level changes, we use our state machine to work out what happens next.
	if (pin == DALI_INPUT_PIN) {
		uint32_t cc = nrfx_timer_capture_get(&timer, NRF_TIMER_CC_CHANNEL0);
		uint32_t pulseWidth = cc;
		pulsewidth_type_t pwt = getPulseWidthType(pulseWidth);
		processStateMachine(pwt, cc);
	}
}


/**
 */
static void timer_callback(nrf_timer_event_t event_type, void* p_context) {
	if (event_type == NRF_TIMER_EVENT_COMPARE1) {
		// Called when a timeout occurs. 
		processStateMachine(PW_TIMEOUT, 0);
	}
}



nrfx_err_t dali_read_init() {
	// Turn on GPIOTE
	LOG_DBG("Enabling DALI module");

	// Configure timer
	timer_cfg.frequency = NRF_TIMER_FREQ_1MHz;
	timer_cfg.bit_width = NRF_TIMER_BIT_WIDTH_32;
	timer_cfg.mode = NRF_TIMER_MODE_TIMER;

	// For some bizarre reason, nrfx doesn't enable its own IRQ, so we do it for them.
	IRQ_DIRECT_CONNECT(TIMER2_IRQn, 0, nrfx_timer_2_irq_handler, 0);
    NRFX_ERROR_CHECK(nrfx_timer_init(&timer, &timer_cfg, timer_callback));

	// Configure Input for GPIOTE, on either edge
	nrfx_gpiote_in_init(DALI_INPUT_PIN, &inputGpioteConfig, inputChanged);
	nrfx_gpiote_in_event_enable(DALI_INPUT_PIN, true);

	// Set up PPI to capture the current time whenever the input toggles, then clear the timer (ready for the next transition)
	NRFX_ERROR_CHECK(nrfx_ppi_channel_alloc(&inputTogglePPIchannel));
	NRFX_ERROR_CHECK(nrfx_ppi_channel_assign(
						inputTogglePPIchannel,
						nrfx_gpiote_in_event_addr_get(DALI_INPUT_PIN),
						nrfx_timer_task_address_get(&timer, NRF_TIMER_TASK_CLEAR)
					));
	NRFX_ERROR_CHECK(nrfx_ppi_channel_fork_assign(inputTogglePPIchannel, nrfx_timer_task_address_get(&timer, NRF_TIMER_TASK_CAPTURE0)));
    NRFX_ERROR_CHECK(nrfx_ppi_channel_enable(inputTogglePPIchannel));

	// Also set a timer that goes off if we've stayed in any one value for too long (resetting us back to a different state.)
	nrfx_timer_extended_compare(&timer, NRF_TIMER_CC_CHANNEL1, 3*BIT_WIDTH_US, NRF_TIMER_SHORT_COMPARE1_CLEAR_MASK, true);
	nrfx_timer_clear(&timer);

	// Our initial state depends on what value the bus is currently at.  It will be one of the reset states, which means we will wait
	// until the bus is idle before startng to read.
	currentInputState = getResetState();
	nrfx_timer_enable(&timer);
	return 0;
}
```

## src/dali_write.c
```c
#include <zephyr/logging/log.h>
#include <zephyr/net/net_pkt.h>
#include <zephyr/net/net_l2.h>
#include <zephyr/net/openthread.h>
#include <openthread/coap.h>
#include <openthread/srp_client.h>
#include <openthread/ip6.h>
#include <openthread/message.h>
#include <openthread/thread.h>
#include <coap_server_client_interface.h>
#include <nrfx_gpiote.h>
#include <nrfx_ppi.h>
#include <nrfx_timer.h>
#include <nrfx_pwm.h>
#include "srp_utils.h"
#include "dali.h"

LOG_MODULE_DECLARE(dali, CONFIG_DALI_LOG_LEVEL);


#define NRFX_ERROR_CHECK(ERR_CODE)                           \
    do                                                      \
    {                                                       \
        const uint32_t LOCAL_ERR_CODE = (ERR_CODE);         \
        __ASSERT((LOCAL_ERR_CODE) == NRFX_SUCCESS, "Call at %s:%d returned %d", (const char*) __FILE__, __LINE__, LOCAL_ERR_CODE); \
    } while (0)


#define PWM_INVERT 0x8000
#define MAX_DALI_BITS 32


static uint16_t outputSequenceValues[MAX_DALI_BITS+3];
static nrf_pwm_sequence_t outputSequence = {
	.values = { .p_common =  outputSequenceValues },
	.length = 1,
	.repeats = 0,
	.end_delay = 0
};

static nrfx_pwm_t pwm = NRFX_PWM_INSTANCE(1);
static nrfx_pwm_config_t pwmConfig = {
	.output_pins = { DALI_OUTPUT_PIN, NRFX_PWM_PIN_NOT_USED, NRFX_PWM_PIN_NOT_USED, NRFX_PWM_PIN_NOT_USED },
	.irq_priority = NRFX_PWM_DEFAULT_CONFIG_IRQ_PRIORITY,
	.base_clock = NRF_PWM_CLK_1MHz,
	.count_mode = NRF_PWM_MODE_UP,
	.top_value = 833,
	.step_mode = NRF_PWM_STEP_AUTO,
	.load_mode = NRF_PWM_LOAD_COMMON,
	.skip_gpio_cfg = true,
	.skip_psel_cfg = false
};



static void pwm_callback(nrfx_pwm_evt_type_t event_type, void *p_context) {
	if (event_type == NRFX_PWM_EVT_FINISHED) {
		LOG_DBG("PWM send finished");
	}
}


nrfx_err_t dali_write_init() {
	// Turn on GPIOTE
	LOG_DBG("Enabling DALI module");


	// We initialise the pin ourselves, as we need to set it to a different drive level
	nrf_gpio_pin_write(DALI_OUTPUT_PIN, 0);
    nrf_gpio_cfg(
        DALI_OUTPUT_PIN,
        NRF_GPIO_PIN_DIR_OUTPUT,
        NRF_GPIO_PIN_INPUT_DISCONNECT,
        NRF_GPIO_PIN_NOPULL,
        NRF_GPIO_PIN_S0H1,
        NRF_GPIO_PIN_NOSENSE);


	// NRFX is not setting up the IRQ properly, so we use our own
	IRQ_DIRECT_CONNECT(PWM1_IRQn, 0, nrfx_pwm_1_irq_handler, 0);
	NRFX_ERROR_CHECK(nrfx_pwm_init(&pwm, &pwmConfig, pwm_callback, NULL));

	return 0;
}


void dali_abort_write() {
	nrfx_pwm_stop(&pwm, true);	
}



void dali_send(uint32_t output, size_t numBits) {
	int bitPos = 0;

	__ASSERT(numBits <= MAX_DALI_BITS, "Attempt to send more than 32 bits via dali");

	// First bit is a start bit (a logical 1)
	outputSequenceValues[bitPos++] = PWM_INVERT | HALF_BIT_WIDTH_US;

	// Loop through each of the bits, starting with the MSB
	for (uint32_t bitMask = 1 << (numBits-1); bitMask != 0; bitMask >>=1) {
		// We always have the same duty, but we flip the polarity depending on if the bit is set or not.
		outputSequenceValues[bitPos++] = ((output & bitMask) ? 0x8000 : 0) | HALF_BIT_WIDTH_US;
	}
	// Add the stop bits (2 bit periods where it is just high)
	outputSequenceValues[bitPos++] = PWM_INVERT;
	outputSequenceValues[bitPos++] = PWM_INVERT;
	outputSequence.length = bitPos;

	nrfx_pwm_simple_playback(&pwm, &outputSequence, 1, 0);
}
```

## src/srp_utils.c
```c
/*
 * Copyright (c) 2020 Nordic Semiconductor ASA
 *
 * SPDX-License-Identifier: LicenseRef-Nordic-5-Clause
 */

#include <zephyr/logging/log.h>
#include <zephyr/net/net_pkt.h>
#include <zephyr/net/net_l2.h>
#include <zephyr/net/openthread.h>
#include <openthread/coap.h>
#include <openthread/srp_client.h>
#include <openthread/ip6.h>
#include <openthread/message.h>
#include <openthread/thread.h>
#include <coap_server_client_interface.h>

#include "srp_utils.h"

LOG_MODULE_REGISTER(ot_srp_utils, CONFIG_OT_SRP_UTILS_LOG_LEVEL);


otSrpClientService lightService = {
	.mName = "_ccpeedsw._udp",
	.mPort = COAP_PORT,
	.mInstanceName = "CCPEED Switch", ///< The service instance name label (not the full name).
	.mSubTypeLabels = NULL,           ///< Array of service sub-type labels (must end with `NULL` or can be `NULL`).
    .mTxtEntries = NULL,              ///< Array of TXT entries (number of entries is given by `mNumTxtEntries`).
    .mNumTxtEntries = 0,              ///< Number of entries in the `mTxtEntries` array.
    .mPriority = 0,                   ///< The service priority.
    .mWeight = 0,                     ///< The service weight.
};



/**
 * @brief Registers us as a SRP service, so that the controllers on the network can discover us.
 * 
 * @return int standard OT error code.
 */
int srp_init()
{
	otError error;

	otInstance *ot = openthread_get_default_instance();

	otSrpClientEnableAutoStartMode(ot, NULL, NULL);
	
	// TODO use the deviceID as the hostname.
	error = otSrpClientSetHostName(ot, "ccpeedsw");
	if (error != OT_ERROR_NONE) {
		LOG_ERR("Failed to set SRP hostname. Error: %d", error);
		goto end;
	}

	error = otSrpClientEnableAutoHostAddress(ot);
	if (error != OT_ERROR_NONE) {
		LOG_ERR("Failed to set SRP addresses. Error: %d", error);
		goto end;
	}

	// TODO add some TXT records to represent the config (which group of lights it addresses, how many buttons, etc..)
	error = otSrpClientAddService(ot, &lightService);
	if (error != OT_ERROR_NONE) {
		LOG_ERR("Failed to add Service. Error: %d", error);
		goto end;
	}

end:
	return error == OT_ERROR_NONE ? 0 : 1;
}
```

## src/srp_utils.h
```c
/*
 * Copyright (c) 2020 Nordic Semiconductor ASA
 *
 * SPDX-License-Identifier: LicenseRef-Nordic-5-Clause
 */

#ifndef __SRP_UTILS_H__
#define __SRP_UTILS_H__


int srp_init();
#endif
```
